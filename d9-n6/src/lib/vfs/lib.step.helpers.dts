declare namespace O23 {
	type Undefinable<T> = T | undefined;
	type DateTime = string;

	interface Config {
		/** get string value of given name */
		getString(name: string, defaultValue?: string): Undefinable<string>;
		/** get boolean value of given name */
		getBoolean(name: string, defaultValue?: boolean): Undefinable<boolean>;
		/** get number value of given name */
		getNumber(name: string, defaultValue?: number): Undefinable<number>;
		/** get json object of given name */
		getJson<R>(name: string, defaultValue?: R): Undefinable<R>;
	}

	interface Logger {
		/** Write a 'log' level log.  */
		log(message: any, ...optionalParams: any[]): void;
		/** Write an 'error' level log.  */
		error(message: any, ...optionalParams: any[]): void;
		/** Write a 'warn' level log.  */
		warn(message: any, ...optionalParams: any[]): void;
		/** Write a 'debug' level log.  */
		debug?(message: any, ...optionalParams: any[]): void;
		/** Write a 'verbose' level log.  */
		verbose?(message: any, ...optionalParams: any[]): void;
	}

	interface PipelineStepDateHelper {
		/**
		 * Get current datetime on configured format by CFG_FORMAT_DATETIME, default is 'YYYY-MM-DD HH:mm:ss'.
		 */
		now(): DateTime;
		// @ts-ignore
		get dayjs(): ((date?: dayjs.ConfigType) => dayjs.Dayjs)
			// @ts-ignore
			& ((date?: dayjs.ConfigType, format?: dayjs.OptionType, strict?: boolean) => dayjs.Dayjs)
			// @ts-ignore
			& ((date?: dayjs.ConfigType, format?: dayjs.OptionType, locale?: string, strict?: boolean) => dayjs.Dayjs)
			// @ts-ignore
			& { isDayjs: (d: any) => d is dayjs.Dayjs; unix: (t: number) => dayjs.Dayjs };
	}

	// @ts-ignore
	type PipelineStepMathHelper = MathJsInstance;
	// @ts-ignore
	type PipelineStepDecimalHelper = (value: Decimal.Value) => Decimal;

	interface PipelineStepErrorOptions {
		// exactly same as http status
		status: number;
		code: string;
		reason: string;
	}

	interface CatchableError extends Error {
		getCode(): string;
	}

	interface UncatchableError extends Error {
		getCode(): string;
	}

	interface ExposedUncatchableError extends UncatchableError {
		getStatus(): number;
	}

	// TODO need to import nodejs Buffer
	type NodeJSBuffer = any;

	interface PipelineStepFileOptions {
		name?: string;
		type?: string;
		content: string | NodeJSBuffer;
	}

	interface PipelineStepFile {
		$file: Symbol;
		name?: string;
		type?: string;
		content: NodeJSBuffer;
	}

	interface IStepHelpersUtils {
		$nano: (size?: number) => string;
		$ascii: (size?: number) => string;
		$errors: {
			catchable: (options: Omit<PipelineStepErrorOptions, 'status'>) => never;
			// eslint-disable-next-line @typescript-eslint/no-explicit-any
			isCatchable: (e: any) => e is CatchableError;
			exposed: (options: PipelineStepErrorOptions) => never;
			// eslint-disable-next-line @typescript-eslint/no-explicit-any
			isExposed: (e: any) => e is ExposedUncatchableError;
			uncatchable: (options: Omit<PipelineStepErrorOptions, 'status'>) => never;
			// eslint-disable-next-line @typescript-eslint/no-explicit-any
			isUncatchable: (e: any) => e is UncatchableError;
		};
		/** create a file */
		$file: (options: PipelineStepFileOptions) => PipelineStepFile;
		$clearContextData: () => symbol;
		/** @deprecated */
		// eslint-disable-next-line @typescript-eslint/no-explicit-any
		isEmpty: (value: any) => boolean;
		/** @deprecated */
		// eslint-disable-next-line @typescript-eslint/no-explicit-any
		isNotEmpty: (value: any) => boolean;
		/** @deprecated */
		// eslint-disable-next-line @typescript-eslint/no-explicit-any
		isBlank: (value: any) => boolean;
		/** @deprecated */
		// eslint-disable-next-line @typescript-eslint/no-explicit-any
		isNotBlank: (value: any) => boolean;
		/** @deprecated */
		// eslint-disable-next-line @typescript-eslint/no-explicit-any
		trim: (value: any) => string;
		// @ts-ignore
		touch: (value: any) => n19n1.IValueOperator;
		// eslint-disable-next-line @typescript-eslint/no-explicit-any
		noop: (value: any) => void;
		// eslint-disable-next-line @typescript-eslint/no-explicit-any
		asyncNoop: (value: any) => Promise<void>;
	}

	interface PipelineStepHelpers extends IStepHelpersUtils {
		$config: Config;
		$logger: Logger;
		$date: PipelineStepDateHelper;
		$math: PipelineStepMathHelper;
		$decimal: PipelineStepDecimalHelper;

		/** create an exposed uncatchable error*/
		$error: (options: PipelineStepErrorOptions) => never;
		$errorCodes: Readonly<Record<string, string>>;

		// eslint-disable-next-line @typescript-eslint/no-explicit-any
		[key: string]: any;
	}
}

declare const $helpers: O23.PipelineStepHelpers;
declare const $: O23.PipelineStepHelpers;
